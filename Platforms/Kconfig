## Platforms/Kconfig
```kconfig
choice
	prompt "Platform select"

	config PLATFORM_NONE
		bool "NONE"
	
  source "$OUTPUT_DIR/Kconfig/platform.autogen"
endchoice
```

## Platforms/ausbee_servo_module_v0.1/Kconfig
```kconfig
config PLATFORM_AUSBEE_SERVO_MODULE_V0_1
  bool "AUSBEE Servo Module V0.1"
  depends on STM32F10X_STDPERIPH_DRIVER
  
  comment "AUSBEE Servo Module V0.1 require stm32f10x_StdPeriph_Driver"
  depends on !STM32F10X_STDPERIPH_DRIVER
```

## Platforms/stm32f4discovery/Kconfig
```kconfig
config PLATFORM_STM32F4DISCOVERY
  bool "STM32F4DISCOVERY"
  depends on STM32F4XX_STDPERIPH_DRIVER
  
  comment "STM32F4DISCOVERY require stm32f4xx_StdPeriph_Driver"
  depends on !STM32F4XX_STDPERIPH_DRIVER
```
